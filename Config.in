## Config.in
~~~~kconfig
menuconfig BR2_EXTERNAL_TIMESYS_VIGILES
    bool "Enable Timesys Vigiles CVE Check"
    default y
    help
      This option enables an additional Post-Image step that gathers metadata
      about the installed packages (name, version, applied patches, etc). and
      submits a SBOM to the Timesys LinuxLink Vigiles service in exchange
      for a report that lists the CVEs known to affect the configuration.

      The process will also collect and submit the .config files for the
      Linux Kernel and U-Boot (if configured) and submit them along with the
      SBOM for additional CVE filtering.

      The SBOM, config files and report will be placed in a subdirectory
      of the build by default:

        vigiles/
        |-- buildroot-rootfs-cve.json
        |-- buildroot-rootfs-report.txt
        |-- linux-4.14.98.config
        |-- uboot-2018.03.config

      In order to receive a full online and text report, a (free) Timesys
      Linuxlink account must be obtained and the associated key configured
      below for the service.

      More information can be found here:

        https://www.timesys.com/security/vigiles/


if BR2_EXTERNAL_TIMESYS_VIGILES

comment "Vigiles Kernel CVE Reporting Options"

config VIGILES_ENABLE_KERNEL_CONFIG
    bool "Enable Linux Kernel .config Filtering"
    depends on BR2_LINUX_KERNEL
    default y
    help
      If selected, this option will enable Linux Kernel .config filtering
      of reported CVEs by the Timesys LinuxLink Vigiles service.

      This option is enabled by default and greatly reduces False-Positive
      matches of CVEs that are applicable to the kernel that will run on the
      Target.

      The .config is automatically found based on the kernel that's configured
      with Buildroot through standard means (this interface). The following
      option allows one to specify the location of the kernel's .config file
      if e.g. it's built from an external location.

      If unsure, choose Y.


config BR2_EXTERNAL_VIGILES_KERNEL_CONFIG
    string "Location of Linux Kernel .config file"
    default auto
    depends on VIGILES_ENABLE_KERNEL_CONFIG
    help
      By default, the Linux Kernel .config file that is used to do CVE
      filtering is located automatically.

      This option allows one to specify a custom location of a Linux Kernel
      .config file if, for instance, it is built from an external tree and
      therefore not included in the Buildroot tree.

      If the kernel is included in the Buildroot tree and built by default
      in the standard build process, or if you are unsure, leave this option
      with its default value of 'auto'.

      If unset, Linux Kernel .config filtering will be disabled.

      If the value indicates a non-existent file, a warning will be displayed
      and .config filtering will not be enabled, but the Vigiles CVE check
      will still function.


config VIGILES_ENABLE_UBOOT_CONFIG
    bool "Enable U-Boot .config Filtering"
    depends on BR2_TARGET_UBOOT
    default y
    help
      If selected, this option will enable U-Boot configuration filtering of
      reported CVEs by the Timesys LinuxLink Vigiles service.

      This option is enabled by default and reduces False-Positive matches of
      CVEs that are applicable to the bootloader that will run on the Target.

      The .config is automatically found based on the U-Boot release that's
      configured with Buildroot through standard means (this interface).
      The following option allows one to specify the location of a U-Boot
      .config file if e.g. it's built from an external location.

      If unsure, choose Y.

config BR2_EXTERNAL_VIGILES_UBOOT_CONFIG
    string "Location of U-Boot .config file"
    default auto
    depends on VIGILES_ENABLE_UBOOT_CONFIG
    help
      By default, the U-Boot .config file that is used to do CVE filtering is
      located automatically based on the top-level Buildroot configuration.

      This option allows one to specify a custom location of a U-Boot .config
      file if, for instance, it is built from an external tree and therefore
      not included in the Buildroot tree.

      If U-Boot is included in the Buildroot tree and built by default in the
      standard build process, or if you are unsure, leave this option with its
      default value of 'auto'.

      ** NOTE ** The U-Boot configuration that is collected and used for CVE
      filtering is composed of _both_ the U-Boot .config file (as generated
      from the Kconfig process) AND include/autoconf.mk (which is generated
      automatically by a post-configuration step). If you specify a custom
      file path, it is assumed that it contains all Kconfig options (i.e. the
      contents of both files in your external tree.

      If unset, U-Boot .config filtering will be disabled.

      If the value indicates a non-existent file, a warning will be displayed
      and .config filtering will not be enabled, but the Vigiles CVE check
      will still function.


comment "Customizing / Amending Vigiles Report"

config BR2_EXTERNAL_VIGILES_MANIFEST_NAME
    string "Custom SBOM and Report Name"
    help
      By default, the file names of the Vigiles SBOM to be uploaded and
      the CVE Report that is generated are given names based on the values of
      BR2_HOSTNAME and BR2_DEFCONFIG (or the target CPU).

      This option may be set to a custom value (e.g. an auto-generated build
      string) for tracking/reporting purposes.


config BR2_EXTERNAL_VIGILES_SUBFOLDER_NAME
    string "Subfolder name"
    depends on !VIGILES_GENERATE_SBOM_ONLY
    help
      By default, your SBOM will be uploaded to the location specified in
      the Dashboard Config. If a subfolder name is specified, Vigiles will
      first check if a subfolder with that name exists in that location
      and upload it there. Otherwise, a subfolder will be created to upload to.


config BR2_EXTERNAL_VIGILES_INCLUDE_CSV
    string "Additional Packages to Include in Report"
    help
      This option may be set to the pathname of a (CSV) file containing a list
      of packages (and optionally their version(s)) to include in the Vigiles
      SBOM and Report when checking for CVEs.

      This is useful when additional software is included on the final system
      that may not be built through the regular Buildroot process and therefore
      wouldn't be included by default in the generated Vigiles SBOM.

      If unsure, leave unset.

config BR2_EXTERNAL_VIGILES_EXCLUDE_CSV
    string "Packages to Exclude from Report"
    help
      This option may be set to the pathname of a (CSV) file containing a list
      of packages to exclude from the Vigiles SBOM and Report when checking
      for CVEs.

      This is useful when packages that are built by default and are (or appear
      to be) installed on the final system, but are considered erroneous or
      superflous to the Vigiles CVE Report.

      For example, a Linux Kernel may be built by default that is not used in
      the final system, and instead replaced by an externally-built kernel.
      The set of CVEs reported for the built-in kernel may then contain false-
      positives, or worse: omit relevant CVEs.

      See the companion option "Additional Packages to Include in Report" to
      include packages in the Vigiles SBOM and Report that are built
      externally.

      If unsure, leave unset.

config BR2_EXTERNAL_VIGILES_WHITELIST_CSV
	string "CVEs to Whitelist in Report"
	help
	  This option may be set to the pathname of a (CSV) file containing a list
	  of CVE IDs to mark as 'Whitelisted'.

	  This is useful when there are CVEs associated with a package that are
	  known to not affect a particular machine or configuration. Typically, a
	  Buildroot package would specify these in their individual Makefile's
	  IGNORE_CVES variable, but in the case that there are additional CVEs to
	  ignore/whitelist, this option may be used.

	  Please see the Vigiles Readme for more information.

	  If unsure, leave unset.

config BR2_EXTERNAL_VIGILES_UPLOAD_ONLY
    bool "Upload SBOM Only"
    depends on !VIGILES_GENERATE_SBOM_ONLY
    help
      In some cases, it may be desired to upload the Vigiles SBOM for a
      build without generating a CVE Report. This can speed up build times and
      ease the reporting of automated bulk builds.

      This behavior can be enabled by enabling this option.

      Instead of a text report and a link to the online report, a link to the
      Vigiles Dashboard Product Workspace (as specified with
      VIGILES_DASHBOARD_CONFIG) will be displayed, from where it can be then be
      scanned by the Vigiles Service.

      If unsure, choose N.


comment "Timesys LinuxLink Account Options"

config BR2_EXTERNAL_VIGILES_KEY_FILE
    string "Timesys LinuxLink Key Location"
    default "$(HOME)/timesys/linuxlink_key"
    help
      This option specifies the location of your default Timesys LinuxLink Key
      File, if it is different than $(HOME)/timesys/linuxlink_key.

      This option can be overridden on the command line by setting the
      environment variable VIGILES_KEY_FILE to the location of an alternate Key
      File.

      The Key File is needed to enable full reporting of the applicable CVEs
      on the Target. One can be obtained by registering for a free (or
      fee-based premium) Timesys LinuxLink account:
        https://linuxlink.timesys.com/docs/wiki/engineering/LinuxLink_Key_File

      Once registered, the Key File can be downloaded and this option should
      indicate its location.

      If the Key File does not exist, the Vigiles CVE check will still function
      in Demo Mode and the results will only show a high-level summary of CVE
      vulnerability.


comment "Timesys Vigiles Dashboard Options"
    depends on !VIGILES_GENERATE_SBOM_ONLY

config VIGILES_ENABLE_DASHBOARD_CONFIG
    bool "Use a custom Vigiles Dashboard Configuration"
    default n
    depends on !VIGILES_GENERATE_SBOM_ONLY

config BR2_EXTERNAL_VIGILES_DASHBOARD_CONFIG
    string "Timesys Vigiles Dashboard Config Location"
    depends on VIGILES_ENABLE_DASHBOARD_CONFIG
    default "$(HOME)/timesys/dashboard_config"
    help
      This option specifies the location of your default Timesys Dashboard
      Config File, if it is different than $(HOME)/timesys/dashboard_config.

      This option can be overridden on the command line by setting the
      environment variable VIGILES_DASHBOARD_CONFIG to the location of an
      alternate Dashboard Config file.

      By default your SBOM will be uploaded to your "Private Workspace"
      Product on the Vigiles Dashboard. This can be changed by downloading the
      "Dashboard Config" for an alternative Product and/or Folder.

      Dashboard Config files will be downloaded by default to e.g.
      ```"${HOME}/Downloads/dashboard_config"```. Once moving and/or renaming
      it as necessary, you can control the behavior of Vigiles for Buildroot
      by specifying the path here.

      New Products can be defined by clicking on the "New Product" product
      link and specifying a name. To download the Dashboard Config for the
      top-level folder of that Product, click on the "Product Settings" link
      and then the "Download Dashboard Config" button.

      Once a new product is created, sub-folders may be created by clicking on
      the "Create Folder" and specifying a name. The Dashboard Config for that
      Folder (in that Product) may be downloaded by first clicking on/opening
      the Folder, then clicking the "Folder Settings" link and finally the
      "Download Dashboard Config" button.


comment "Advanced Vigiles / Debug Options"

config VIGILES_ENABLE_EXPERT
    bool "Enable Vigiles Advanced and Debugging Options (Expert)"
    default n
    help
      This option enables some development options for debugging the
      Vigiles SBOM generation and CVE reporting.

      If unsure, say N.

config VIGILES_DEBUG_OUTPUT
    bool "Enable Verbose Console Output"
    default n
    help
      This option enables "Debug Output" on the command-line when running the
      vigiles-buildroot.py script.

config VIGILES_GENERATE_INTERMEDIATE_FILES
    bool "Write Intermediate JSON Files of Collected Metadata"
    depends on VIGILES_ENABLE_EXPERT
    default n

config VIGILES_INCLUDE_VIRTUAL_PACKAGES
    bool "Include virtual packages in SBOM"
    default n
    help
      This option will include virtual packages in generated SBOM.

config BR2_EXTERNAL_VIGILES_OUTPUT
    string "Vigiles output location"
    help
      This option specifies the location of the vigiles output files
      like SBOM, report and vigiles logs

choice
    prompt "Select SBOM format"
    default VIGILES_SBOM_FORMAT_VIGILES
    help
        Select the SBOM format. Default is Vigiles JSON format.

config VIGILES_SBOM_FORMAT_VIGILES
    bool "Vigiles JSON"
    help
        Generate SBOM in Vigiles JSON format

config VIGILES_SBOM_FORMAT_CYCLONEDX_1.4
    bool "CycloneDX 1.4 JSON"
    help
        Generate SBOM in CycloneDX 1.4 JSON format

endchoice

config VIGILES_NOTIFICATION_SUBSCRIBE
    bool "Subscribe SBOM Report Notification"
    default n
    help
      Set this option to receive notifications for SBOM reports.

if VIGILES_NOTIFICATION_SUBSCRIBE

choice
    prompt "Set SBOM Report Notification Frequency"
    default VIGILES_NOTIFICATION_SUBSCRIBE_NONE
    help
      Select how often you want to receive SBOM report notifications.

config VIGILES_NOTIFICATION_SUBSCRIBE_NONE
    bool "None"

config VIGILES_NOTIFICATION_SUBSCRIBE_DAILY
    bool "Daily"

config VIGILES_NOTIFICATION_SUBSCRIBE_WEEKLY
    bool "Weekly"

config VIGILES_NOTIFICATION_SUBSCRIBE_MONTHLY
    bool "Monthly"

endchoice

endif

config VIGILES_GENERATE_SBOM_ONLY
    bool "Generate SBOM only"
    default n
    help
      This option will only generate SBOM locally. 

config VIGILES_REQUIRE_ALL_CONFIGS
    bool "Require all config files"
    default n
    help
      Throw an error if Config.in files are missing.

config VIGILES_REQUIRE_ALL_HASHFILES
    bool "Require all hashfiles"
    default n
    help
      Throw an error if hashfiles are missing.

endif
~~~~
